## boards/arm/npr/Kconfig.board
```kconfig
# NPR board configuration

# SPDX-License-Identifier: MIT

config BOARD_NPR
    bool "np-r"
    depends on SOC_NRF52840_QIAA
```

## boards/arm/npr/Kconfig.defconfig
```kconfig
config BOARD
    default "bt60"

if USB

config USB_NRFX
    default y

config USB_DEVICE_STACK
    default y

endif # USB

config BT_CTLR
    default BT

config ZMK_KEYBOARD_NAME
    default "NP-R"
```
